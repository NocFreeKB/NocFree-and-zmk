## Kconfig
```kconfig
# SPDX-License-Identifier: MIT

config NOCFREE_KSCAN_PCA9555
    bool "NocFree PCA9555 key-input scanner"
    default y
    depends on DT_HAS_NOCFREE_KSCAN_PCA9555_ENABLED
    select I2C
    select KSCAN
    select ZMK_DEBOUNCE
    help
      Poll PCA9555-compatible I2C expanders that are wired as independent key
      inputs and report them through ZMK's KSCAN interface.

      The driver owns the expander registers directly instead of layering on
      Zephyr's generic PCA GPIO driver. See docs/architecture.md for why that
      is required on the ZMK-pinned Zephyr revision.

if NOCFREE_KSCAN_PCA9555

config NOCFREE_KSCAN_PCA9555_INIT_PRIORITY
    int "NocFree PCA9555 scanner init priority"
    default 90
    help
      Must be later than CONFIG_I2C_INIT_PRIORITY so the bus is available when
      the scanner writes and verifies the expander configuration.

config NOCFREE_KSCAN_PCA9555_STACK_SIZE
    int "NocFree PCA9555 scan thread stack size"
    default 1024
    help
      Stack for the dedicated scan queue. The scan itself is shallow; the depth
      is the synchronous I2C transfer.

config NOCFREE_KSCAN_PCA9555_PRIORITY
    int "NocFree PCA9555 scan thread priority"
    default 4
    help
      Preemptible priority for the scan queue. Scanning must not run on the
      cooperative system work queue, where each blocking expander read would
      delay the key events the scan has just produced and, on a split central,
      the events arriving from the peripheral.

endif # NOCFREE_KSCAN_PCA9555

config NOCFREE_RECOVERY_CDC_1200_TOUCH
    bool "Enter the preserved UF2 bootloader when CDC baud is set to 1200"
    default y
    depends on USB_CDC_ACM && CDC_ACM_DTE_RATE_CALLBACK_SUPPORT
    depends on DT_HAS_ZEPHYR_CDC_ACM_UART_ENABLED
    depends on RETENTION_BOOT_MODE
    help
      Provide the conventional 1200-baud touch recovery trigger on a USB CDC
      interface. Unlike the keymap's &bootloader binding -- which acts on the
      half whose key triggered it and, for a split peripheral, needs a working
      split link -- this path only needs USB, so it recovers a half no matter
      what state its radio or pairing is in.
```

## boards/nocfree/nocfree_and/board.yml
```yaml
# SPDX-License-Identifier: MIT

boards:
  - name: nocfree_and_left
    vendor: nocfree
    socs:
      - name: nrf52833
        variants:
          - name: zmk
  - name: nocfree_and_right
    vendor: nocfree
    socs:
      - name: nrf52833
        variants:
          - name: zmk
```

## dts/bindings/kscan/nocfree,kscan-pca9555.yaml
```yaml
# SPDX-License-Identifier: MIT

description: |
  Keyboard scanner for keys wired directly to PCA9555-compatible I2C expander
  inputs.

  Each scan reads every listed expander exactly once (a two-byte read of the
  input port pair) and then resolves the declared key positions from the cached
  port words. Scan cost is therefore one I2C transaction per expander, not one
  per key.

  The scanner owns the expander configuration and polarity-inversion registers
  and verifies them at init, so a warm MCU reset cannot leave stale hardware
  inversion in place. See docs/architecture.md.

compatible: "nocfree,kscan-pca9555"

include: kscan.yaml

properties:
  expanders:
    type: phandles
    required: true
    description: |
      Every nocfree,pca9555-keys node this scanner owns, in the order they are
      read. All of them must sit on the same I2C controller.

  key-inputs:
    type: phandle-array
    required: true
    specifier-space: key
    description: |
      One <&expander bit> entry per key position, in KSCAN column order. Bits
      0-7 are port 0 and bits 8-15 are port 1. Unpopulated matrix positions are
      excluded simply by leaving them out of this list, so the column index of
      every listed key is its index in this array.

      Key inputs are active low: a pressed key pulls its expander input to
      ground against the part's internal pull-up.

  debounce-press-ms:
    type: int
    default: 5
    description: Stable active time required before a press is reported.

  debounce-release-ms:
    type: int
    default: 5
    description: Stable inactive time required before a release is reported.

  debounce-scan-period-ms:
    type: int
    default: 3
    description: |
      Poll period while any key is pressed or debouncing. One scan reads every
      expander over I2C, so this must comfortably exceed the total transfer
      time for the configured bus speed or the scanner cannot hold its
      schedule. See docs/architecture.md for the budget.

  poll-period-ms:
    type: int
    default: 10
    description: |
      Poll period while every key is released and stable. On a split keyboard
      this also bounds how stale one half's view can be relative to the other.
```

## dts/bindings/kscan/nocfree,pca9555-keys.yaml
```yaml
# SPDX-License-Identifier: MIT

description: |
  A PCA9555-compatible 16-bit I2C expander whose two 8-bit ports are wired as
  independent key inputs.

  This node carries no driver of its own. It exists so that the
  nocfree,kscan-pca9555 scanner can address the part through the normal
  Zephyr I2C devicetree bus model, and so individual key positions can be
  written as <&expander bit> in the scanner's key-inputs list.

compatible: "nocfree,pca9555-keys"

include: [i2c-device.yaml]

properties:
  "#key-cells":
    type: int
    required: true
    const: 1

key-cells:
  - bit
```
